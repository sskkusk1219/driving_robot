VERSION "MEIDEN_MEIDACS CAN Signals"

NS_ :

BS_:

BU_: RPi

BO_ 288 MEIDACS_Frame0: 8 RPi
 SG_ Speed : 7|32@0- (0.01,0) [0|0] "km/h"  RPi
 SG_ dummy : 39|32@0- (1,0) [0|0] "-"  RPi

SIG_VALTYPE_ 288 Speed : 1;
SIG_VALTYPE_ 288 dummy : 1;
